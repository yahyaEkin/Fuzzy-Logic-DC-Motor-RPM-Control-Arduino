/*FUZZY LOGIC CONTROL IMPLEMENTATION ON ARDUINO
  YAHYA EKIN  03.06.2024
*/
#include <Arduino.h>
#include <SPI.h>
#include <Wire.h>
#include <LiquidCrystal_I2C.h>

LiquidCrystal_I2C lcd(0x27,16,2);  // set the LCD address to 0x27 for a 16 chars and 2 line display

#define DIR1 7
#define DIR2 8
#define ENABLE 3

const uint16_t LookUpTable[61][61] PROGMEM = {
{-182, -182, -182, -182, -182, -182, -182, -182, -181, -180, -180, -179, -179,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 -42, -42},
{-182, -182, -182, -182, -182, -182, -182, -182, -181, -180, -180, -179, -179,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 -42, -42},
{-181, -181, -181, -181, -181, -181, -181, -181, -181, -173, -171, -169, -169,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 -42, -42},
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{42, 42, 42, 42, 42, 42, 42, 42, 42, 56, 78, 91, 102,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 182, 182}
};

int inputPWM[51];

unsigned long rpmtime;
float rpmfloat;
unsigned int rpm;
bool tooslow = 1;

int desired_rpm;
int rpm_error = 0;
int previous_rpm_error = 0;
int change_of_rpm_error = 0;
int drivePWM;
int rounded_x_input;
int rounded_y_input;
int Out_PWM=0;
int Previous_Out_PWM=0;

void RPM () {
  rpmtime = TCNT1;
  TCNT1 = 0;
  tooslow = 0;
}

void setup() {
  // put your setup code here, to run once:
  TCCR1A = 0;
  TCCR1B = 0;
  TCCR1B |= (1 << CS12); //Prescaler 256
  TIMSK1 |= (1 << TOIE1); //enable timer overflow
  
  lcd.init();                      // initialize the lcd 
  lcd.init();
  lcd.backlight();
  lcd.setCursor(2,0);
  lcd.print("Fuzzy Logic");
  lcd.setCursor(0,1);
  lcd.print("Motor RPM Control");
 
  // PIN DEFINITIONS
  pinMode(2, INPUT);
  pinMode(A3, INPUT);
  pinMode(DIR1, OUTPUT);
  pinMode(DIR2, OUTPUT);
  pinMode(ENABLE, OUTPUT);

  attachInterrupt(0, RPM, FALLING);
  Serial.begin(9600);

  digitalWrite(DIR1, LOW);
  digitalWrite(DIR2, LOW);

  for(int i = 0; i<=51; i++)
  {
    inputPWM[i] = 5*i;
  }
  Serial.println("InputPWM Array:");
  for(int i = 0; i<=51; i++)
  {
  Serial.println(inputPWM[i]);
  }
  Serial.println("-----");
  drivePWM = 0;

}

ISR(TIMER1_OVF_vect) {
  tooslow = 1;
}

void loop() {
  // put your main code here, to run repeatedly:
  int rawVal = analogRead(A3);
  //Serial.print("rawVal:");
  //Serial.println(rawVal);
  
  int desired_rpm = map(rawVal, 0, 1023, 0, 600);
  

  Serial.print("Motor_RPM:");
  Serial.print(rpm);
  Serial.print(",");

  Serial.print("Desired_RPM ");
  Serial.print(desired_rpm);
  Serial.print(",");
  
  rpm_error = desired_rpm - rpm;
  Serial.print("RPM_Error: ");
  Serial.print(rpm_error);
  Serial.print(",");

  
  change_of_rpm_error = rpm_error - previous_rpm_error;
  Serial.print("Change_of_RPM_Error: ");
  Serial.print(change_of_rpm_error);
  Serial.print(",");

  lcd.clear();
  lcd.backlight();
  lcd.setCursor(0,0);
  lcd.print("MO_R:");
  lcd.setCursor(5,0);
  lcd.print(rpm);
  lcd.setCursor(8,0);
  lcd.print("DE_R:");
  lcd.setCursor(13,0);
  lcd.print(desired_rpm);

  lcd.setCursor(0,1);
  lcd.print("R_Er:");
  lcd.setCursor(5,1);
  lcd.print(rpm_error);
  lcd.setCursor(8,1);
  lcd.print("C_Er:");
  lcd.setCursor(13,1);
  lcd.print(change_of_rpm_error);
  
  
  rounded_x_input  = round(rpm_error / 20.0) * 20;
  rounded_y_input  = round(change_of_rpm_error / 20.0) * 20;
  int selected_x = map(rounded_x_input, -600, 600, 0, 61);
  int selected_y = map(rounded_y_input, -600, 600, 0, 61);
  
  Out_PWM = pgm_read_word(&LookUpTable[selected_y][selected_x]);
  Serial.print(" Fuzzy_Out_PWM:");
  Serial.print(Out_PWM);
  Serial.print(",");
  
  // previous_rpm_error'i güncelle
  previous_rpm_error = rpm_error;
  
  drivePWM = Previous_Out_PWM + (Out_PWM);
  Previous_Out_PWM = drivePWM;
  
  if (Previous_Out_PWM >255 || Previous_Out_PWM<-255)
    Previous_Out_PWM = 0;
  if (drivePWM >255 || drivePWM<-255)
    drivePWM = 0; 
    
  Serial.print(" Previous_Fuzzy_Out_PWM:");
  Serial.print(Previous_Out_PWM);
  Serial.print(",");  
  Serial.print("Drive_PWM:");
  Serial.println(drivePWM); 

  if (drivePWM <0){
    digitalWrite(DIR1, LOW);
    digitalWrite(DIR2, HIGH);
    analogWrite(ENABLE, (-1*(drivePWM)));
  }
  else{
    digitalWrite(DIR1, HIGH);
    digitalWrite(DIR2, LOW);
    analogWrite(ENABLE, drivePWM);
  }
 
  delay(100);
  
  if (tooslow == 1) {
    Serial.print("To SLow to measure!");
  
    if (drivePWM <0){
    digitalWrite(DIR1, LOW);
    digitalWrite(DIR2, HIGH);
    analogWrite(ENABLE, (-1*(drivePWM)));
    }
    else{
    digitalWrite(DIR1, HIGH);
    digitalWrite(DIR2, LOW);
    analogWrite(ENABLE, drivePWM);
    }
    if (drivePWM >255 || drivePWM<-255)
    drivePWM = 0; 
    
    rpm = 0;
  }
  else {
    rpmfloat = 120 / (rpmtime/ 31250.00);
    rpm = round(rpmfloat);
    if (drivePWM >255 || drivePWM<-255)
    drivePWM = 0; 
    if (drivePWM <0)
    {
    digitalWrite(DIR1, LOW);
    digitalWrite(DIR2, HIGH);
    analogWrite(ENABLE, (-1*(drivePWM)));
    }
    else
    {
    digitalWrite(DIR1, HIGH);
    digitalWrite(DIR2, LOW);
    analogWrite(ENABLE, drivePWM);
    }
  }
 
  
}
